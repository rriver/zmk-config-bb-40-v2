## boards/shields/bb_40/Kconfig.defconfig
```kconfig
if SHIELD_BB_40_RIGHT

config ZMK_KEYBOARD_NAME
    default "bb-40 v2"

config ZMK_BLE
    default y

config ZMK_SPLIT_ROLE_CENTRAL
    default y

config INPUT
    default y

config SPI
    default y

config PAW3222
    default y

endif #SHIELD_BB_40_RIGHT


if SHIELD_BB_40_LEFT || SHIELD_BB_40_RIGHT

config NFCT_PINS_AS_GPIOS
    default y

config ZMK_SPLIT
    default y

endif # SHIELD_BB_40_LEFT || SHIELD_BB_40_RIGHT
```

## boards/shields/bb_40/Kconfig.shield
```kconfig
config SHIELD_BB_40_RIGHT
    def_bool $(shields_list_contains,bb_40_right)

config SHIELD_BB_40_LEFT
    def_bool $(shields_list_contains,bb_40_left)
```

## config/west.yml
```yaml
manifest:
  remotes:
    - name: zmkfirmware
      url-base: https://github.com/zmkfirmware
    - name: rriver
      url-base: https://github.com/rriver/
    - name: sekigon-gonnoc  # <-- PAW3222
      url-base: https://github.com/sekigon-gonnoc
    - name: zettaface  # <-- Input Processor Keybind
      url-base: https://github.com/zettaface
    - name: kot149
      url-base: https://github.com/kot149
  projects:
    - name: zmk
      remote: zmkfirmware
      revision: v0.3.0
      import: app/west.yml
    - name: zmk-driver-paw3222
      remote: sekigon-gonnoc
      revision: main
    - name: zmk-input-processor-keybind
      remote: zettaface
      revision: main
    - name: zmk-mouse-gesture
      remote: kot149
      revision: v1
  self:
    path: config
```
